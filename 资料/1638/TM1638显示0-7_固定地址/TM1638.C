/****************************** (C) COPYRIGHT 2013 YQDZ **************************
* 文  件  名      : TM1638.C
* 作      者      : YQDZ
* 淘  宝  店      : http://zyqmcu.taobao.com
* 版      本      : V1.1
* 日      期      : 2013/01/17
* 主  控  MCU     : STC90C516RD+
* 主      频      : 11.0592MHz
* 编  译  器      : Keil C51 V3.8
* 描      述      : TM1638控制数码管依次从0显示到7.
*********************************************************************************/
#include"REG52.H"
#include"TM1638CMD.H"

typedef	unsigned char UINT8;                                                            /* 类型定义 */
typedef unsigned int  UINT16; 

/******************************** 引脚定义 **************************************
                        单片机            TM1638
                         P20                STB
                         P21                CLK
                         P22                DIO                     
********************************************************************************/            
sbit    STB = P2^2;                                                                     /* 定义TM1638片选线 */
sbit    CLK = P2^1;                                                                     /* 定义TM1638时钟线 */
sbit    DIO = P2^0;                                                                     /* 定义TM1638数据输入，输出线 */

/****************************** 共阴数码管码表 ********************************/
const UINT8 CathodeCode[ 0x10 ] = {  0X3F, 0X06, 0X5B, 0X4F, 0X66, 0X6D, 0X7D, 
                                     0X07, 0X7F, 0X6F, 0X77, 0X7C, 0X39, 0X5E, 
                                     0X79, 0X71  };
                                     
UINT8   KeyCode[4];                                                                     /* 保存键值 */

/*******************************************************************************
* 函  数  名      : DelayUs
* 描      述      : 微秒级延时.
* 输      入      : UINT16 Us：
*                   要延时Us的时间.
* 返      回      : 无.
*******************************************************************************/
void DelayUs( UINT16 Us )
{
	while(--Us);
}

/*******************************************************************************
* 函  数  名      : DelayMs
* 描      述      : 毫秒级延时.
* 输      入      : UINT16 Ms：
*                   要延时的Ms时间.
* 返      回      : 无.
*******************************************************************************/
void DelayMs( UINT16 Ms )
{
	while( Ms-- )
	{
		DelayUs(200);																	/* 5次1ms */
		DelayUs(200);
		DelayUs(200);
		DelayUs(200);
		DelayUs(200);
	}
}

/*******************************************************************************
* 函  数  名      : TM1638_WriteCmd
* 描      述      : 向TM1638写入命令.
* 输      入      : UINT8 mCmd：
*                   要发送的命令.
* 返      回      : 无.
*******************************************************************************/
void TM1638_WriteCmd( UINT8 mCmd )
{
    UINT8 i;  
    
	STB = 0;                                                                            /* 使能片选 */
    for( i = 0; i < 8 ; i++ )
    {
        CLK = 0;                                                                        /* 拉低CLK */
        DelayUs(1);
        if( mCmd & 0x01 ) DIO = 1;                                                      /* 发送数据到信号线上，DIO数据线为高 */
        else DIO = 0;                                                                   /* DIO数据线为低 */
        mCmd >>= 1;                                                                     /* 数据右移一位 */
        CLK = 1;                                                                        /* 拉高CLK */
        DelayUs(1);
    }
	STB = 1;                                                                            /* 禁止片选 */
    DelayUs(2);
}

/*******************************************************************************
* 函  数  名      : TM1638_WriteData
* 描      述      : 向TM1638写入数据.
* 输      入      : UINT8 mDig:
*                   对应的数码管地址.
					UINT8 mData：
					对应的数码管显示数据.
* 返      回      : 无.
*******************************************************************************/
void TM1638_WriteData( UINT8 mDig,  UINT8 mData )
{
    UINT8 i;  
    UINT8 SendByte = 0;
    
	STB = 0;                                                                            /* 使能片选 */
    for( i = 0; i < 8 ; i++ )
    {
        CLK = 0;                                                                        /* 拉低CLK */
        DelayUs(1);                                                                     /* 延时1us */
        if( mDig & 0x01 ) DIO = 1;                                                      /* 发送数据到信号线上，DIO数据线为高 */
        else DIO = 0;                                                                   /* DIO数据线为低 */ 
        mDig >>= 1;                                                                    	/* 数据右移一位 */        
        CLK = 1;                                                                        /* 拉高CLK */
        DelayUs(1);
    }

    for( i = 0; i < 8 ; i++ )
    {
        CLK = 0;                                                                        /* 拉低CLK */
        DelayUs(1);
        if( mData & 0x01 ) DIO = 1;                                                     /* 发送数据到信号线上，DIO数据线为高 */
        else DIO = 0;                                                                   /* DIO数据线为低 */ 
        mData >>= 1;                                                                    /* 数据右移一位 */
        CLK = 1;                                                                        /* 拉高CLK */
        DelayUs(1);
    }
	STB = 1;                                                                            /* 禁止片选 */
    DelayUs(2);

}

/*******************************************************************************
* 函  数  名      : main
* 描      述      : 主程序.
* 输      入      : 无.
* 返      回      : 无.
*******************************************************************************/
void main( void )
{
	DelayMs(100);																		/* 上电延时,等待芯片正常工作 */

	TM1638_WriteCmd( ADDRESS_FIX_MODE );                                                /* 地址固定模式 */
	TM1638_WriteCmd( DISPLAY_ON );                                                      /* 开显示 */

	TM1638_WriteCmd( SET_PLUS_WIDTH4 );

	TM1638_WriteData( TM1638_DIG0, CathodeCode[0] );									/* 第一个数码管显示0 */
	TM1638_WriteData( TM1638_DIG1, CathodeCode[1] );									/* 第二个数码管显示1 */
	TM1638_WriteData( TM1638_DIG2, CathodeCode[2] );									/* 第三个数码管显示2 */
	TM1638_WriteData( TM1638_DIG3, CathodeCode[3] );									/* 第四个数码管显示3 */
	TM1638_WriteData( TM1638_DIG4, CathodeCode[4] );									/* 第五个数码管显示4 */
	TM1638_WriteData( TM1638_DIG5, CathodeCode[5] );									/* 第六个数码管显示5 */
	TM1638_WriteData( TM1638_DIG6, CathodeCode[6] );									/* 第七个数码管显示6 */
	TM1638_WriteData( TM1638_DIG7, CathodeCode[7] );									/* 第八个数码管显示7 */

	while(1);                                                                           /* 一直在此循环 */
}
